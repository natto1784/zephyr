## boards/ti/am62l_evm/Kconfig
```kconfig
# Texas Instruments Sitara AM62L EVM
#
# Copyright (c) 2026 Texas Instruments Incorporated
#
# SPDX-License-Identifier: Apache-2.0

if BOARD_AM62L_EVM

config AM62L_EVM_IO_EXPANDER
	bool "Enable I/O expander functionality"
	default n
	select I2C
	select GPIO
	select GPIO_HOGS
	help
	  Automatically configure GPIOs to enable I/O expander functionality.

	  This enables:
	  - Main GPIO0.89 (GPIO_SOC_VOUT0_FET_SEL0_PIN)
	  - TCA6424 GPIO.1 (VOUT0_FET_SEL0)

endif # BOARD_AM62L_EVM
```

## boards/ti/am62l_evm/Kconfig.defconfig
```kconfig
# Texas Instruments Sitara AM62L EVM
#
# Copyright (c) 2026 Texas Instruments Incorporated
#
# SPDX-License-Identifier: Apache-2.0

if AM62L_EVM_IO_EXPANDER

config GPIO_HOGS_INIT_PRIORITY
	default I2C_INIT_PRIORITY

endif # AM62L_EVM_IO_EXPANDER
```

## drivers/adc/Kconfig.mspm0
```kconfig
# SPDX-License-Identifier: Apache-2.0
# Copyright (c) 2026 Texas Instruments
# Copyright (c) 2026 Linumiz

config ADC_MSPM0_ADC12
	bool "TI ADC MSPM0 driver"
	default y
	depends on DT_HAS_TI_MSPM0_ADC12_ENABLED
	select PINCTRL
	help
	  Enable support for ADC12 on the TI MSPM0 series.

config ADC_MSPM0_ADC12_DMA
	bool "TI MSPM0 ADC12 DMA support"
	default y
	depends on ADC_MSPM0_ADC12
	depends on $(dt_compat_any_has_prop,$(DT_COMPAT_TI_MSPM0_ADC12),dmas)
	select DMA
	help
	  Offload ADC12 sequence-complete result transfers (MEMRES to sequence
	  buffer) to DMA instead of the CPU interrupt handler. Automatically
	  available once at least one enabled ti,mspm0-adc12 node declares a
	  "dmas" property; instances without "dmas" keep using the
	  interrupt-driven path unchanged.
```

## dts/bindings/misc/ti,unicomm.yaml
```yaml
# Copyright 2026 Texas Instruments Incorporated
# SPDX-License-Identifier: Apache-2.0

description: Texas Instruments Unified Communication Peripheral

compatible: "ti,unicomm"

include: base.yaml

properties:
  reg:
    required: true

  interrupts:
    required: true
```

## soc/ti/mspm/mspm0l/Kconfig.defconfig
```kconfig
# TI MSPM0L series

# Copyright (c) 2025 Texas Instruments
# Copyright (c) 2025 Linumiz GmbH
# SPDX-License-Identifier: Apache-2.0

if SOC_SERIES_MSPM0L

config NUM_IRQS
	default 32

if SHARED_INTERRUPTS

config SHARED_IRQ_MAX_NUM_CLIENTS
	default 6

endif # SHARED_INTERRUPTS

config MSPM0_I2C_FIFO_DEPTH
	default 4 if SOC_MSPM0L1117

endif # SOC_SERIES_MSPM0L
```
