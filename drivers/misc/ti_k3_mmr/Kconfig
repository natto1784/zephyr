## drivers/misc/ti_k3_mmr/Kconfig
```kconfig
# Copyright (c) 2025 Texas Instruments
# SPDX-License-Identifier: Apache-2.0

config TI_K3_MMR
	bool "TI K3 MMR partition control driver"
	default y
	depends on DT_HAS_TI_K3_MMR_ENABLED
	help
	  This driver is used to lock/unlock MMR control partitions.
```

## drivers/sdhc/Kconfig.ti
```kconfig
config TI_SDHC
	bool "SDHC driver"
	select SDHC_SUPPORTS_NATIVE_MODE
	select EVENTS
	select REGULATOR
	select GPIO
	default y
	depends on DT_HAS_TI_SDHC_ENABLED

	help
	  EMMC host controller interrupt mode support.

if TI_SDHC
config TI_SDHC_ENABLE_ADMA
	bool "ADMA"
	default y
  select DCACHE
	help
	  Auto stop command mode support.

config TI_SDHC_ENABLE_AUTO_STOP
	bool "auto stop command mode"
	default y
	help
	  Auto stop command mode support.

config TI_SDHC_ADMA_DESC_LEN
	int "descriptor length"
	default 32
	help
	  Auto stop command mode support.
endif
```

## tests/drivers/mspi/flash/testcase.yaml
```yaml
# Copyright (c) 2024 Ambiq Micro Inc. <www.ambiq.com>
# SPDX-License-Identifier: Apache-2.0

tests:
  drivers.mspi.flash:
    tags:
      - drivers
      - mspi
      - flash
    filter: dt_compat_enabled("zephyr,mspi-emul-flash") or
            dt_compat_enabled("mspi-atxp032") or
            dt_compat_enabled("ti,k3-mspi-controller")
    harness: ztest
    platform_allow:
      - native_sim
      - apollo3p_evb
      - am243x_evm/am2434/r5f0_0
    integration_platforms:
      - native_sim
      - apollo3p_evb
      - am243x_evm/am2434/r5f0_0
```
