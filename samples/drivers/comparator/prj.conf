## CMakeLists.txt
```
# SPDX-License-Identifier: Apache-2.0

cmake_minimum_required(VERSION 3.28.0)
find_package(Zephyr REQUIRED HINTS $ENV{ZEPHYR_BASE})
project(comparator)

target_sources(app PRIVATE src/main.c)
```

## sample.yaml
```
sample:
  description: Demonstrates the comparator driver with a regular external-channel
    comparison, an internal DAC reference comparison, and window comparator mode.
  name: comparator

common:
  tags:
    - comparator
    - drivers
  filter: dt_alias_exists("sample-comp")
  harness: console
  harness_config:
    type: one_line
    regex:
      - "comparator sample started"

tests:
  sample.drivers.comparator.regular:
    platform_allow:
      - lp_mspm0g3507
      - lp_mspm0g3519
      - lp_mspm0l2228
    integration_platforms:
      - lp_mspm0g3507

  sample.drivers.comparator.dac:
    extra_args:
      - platform:lp_mspm0g3507:EXTRA_DTC_OVERLAY_FILE="boards/lp_mspm0g3507_dac.overlay"
      - platform:lp_mspm0g3519:EXTRA_DTC_OVERLAY_FILE="boards/lp_mspm0g3519_dac.overlay"
      - platform:lp_mspm0l2228:EXTRA_DTC_OVERLAY_FILE="boards/lp_mspm0l2228_dac.overlay"
    platform_allow:
      - lp_mspm0g3507
      - lp_mspm0g3519
      - lp_mspm0l2228

  sample.drivers.comparator.window:
    extra_args:
      - platform:lp_mspm0g3507:EXTRA_DTC_OVERLAY_FILE="boards/lp_mspm0g3507_window.overlay"
      - platform:lp_mspm0g3519:EXTRA_DTC_OVERLAY_FILE="boards/lp_mspm0g3519_window.overlay"
    platform_allow:
      - lp_mspm0g3507
      - lp_mspm0g3519
```

## prj.conf
```kconfig
CONFIG_COMPARATOR=y
CONFIG_LOG=y
```

## boards/lp_mspm0g3507.overlay
```dts
/*
 * Copyright (c) 2026 Texas Instruments Incorporated
 * Copyright (c) 2026 Linumiz
 *
 * SPDX-License-Identifier: Apache-2.0
 */

/ {
	aliases {
		sample-comp = &comp0;
	};
};

&comp0 {
	status = "okay";
	positive-inputs = <2>; /* COMP0_IN2+, PA14 */
	negative-inputs = <3>; /* TODO: verify channel/pin for external signal on this board */
	pinctrl-0 = <&comp0_out_pa7>; /* TODO: verify comp0_out pin exposed on this board */
	pinctrl-names = "default";
	ti,mode = "fast";
};
```

## boards/lp_mspm0g3507_window.overlay
```dts
/*
 * Copyright (c) 2026 Texas Instruments Incorporated
 * Copyright (c) 2026 Linumiz
 *
 * SPDX-License-Identifier: Apache-2.0
 */

&comp1 {
	status = "okay";
};

&comp0 {
	ti,window-mode-enable;
	ti,window-companion = <&comp1>;
	ti,window-lower-threshold = <0>; /* TODO: verify desired lower-threshold channel */
};
```

## boards/lp_mspm0g3519.overlay
```dts
/*
 * Copyright (c) 2026 Texas Instruments Incorporated
 * Copyright (c) 2026 Linumiz
 *
 * SPDX-License-Identifier: Apache-2.0
 */

/ {
	aliases {
		sample-comp = &comp0;
	};
};

&comp0 {
	status = "okay";
	positive-inputs = <2>; /* COMP0_IN2+, PA14 */
	negative-inputs = <1>; /* TODO: verify channel/pin for external signal on this board */
	pinctrl-0 = <&comp0_out_pa7>; /* TODO: verify comp0_out pin exposed on this board */
	ti,filter-enable;
	ti,filter-delay = <2700>;
pinctrl-names = "default";
	ti,mode = "fast";
};
```

## boards/lp_mspm0g3519_dac.overlay
```dts
/*
 * Copyright (c) 2026 Texas Instruments Incorporated
 * Copyright (c) 2026 Linumiz
 *
 * SPDX-License-Identifier: Apache-2.0
 */

&comp0 {
	ti,reference-source = "vdda_dac";
	ti,reference-terminal = "neg";
	ti,reference-dac-code0 = <128>;
};
```

## boards/lp_mspm0g3519_window.overlay
```dts
/*
 * Copyright (c) 2026 Texas Instruments Incorporated
 * Copyright (c) 2026 Linumiz
 *
 * SPDX-License-Identifier: Apache-2.0
 */

&comp1 {
	status = "okay";
};

&comp0 {
	negative-inputs = <1>; /* COMP0_IN1-, PA17 (upper threshold) */
	ti,window-mode-enable;
	ti,window-companion = <&comp1>;
	ti,window-lower-threshold = <0>; /* COMP1_IN0-, PB27 (lower threshold) */
};
```

## boards/lp_mspm0l2228.overlay
```dts
/*
 * Copyright (c) 2026 Texas Instruments Incorporated
 * Copyright (c) 2026 Linumiz
 *
 * SPDX-License-Identifier: Apache-2.0
 */

/ {
	aliases {
		sample-comp = &comp0;
	};
};

&comp0 {
	status = "okay";
	positive-inputs = <2>; /* TODO: verify channel/pin for external signal on this board */
	negative-inputs = <3>; /* TODO: verify channel/pin for external signal on this board */
	pinctrl-0 = <&comp0_out_pa07>; /* TODO: verify comp0_out pin exposed on this board */
	pinctrl-names = "default";
	ti,mode = "fast";
};
```

## src/main.c
```c
/*
 * Copyright (c) 2026 Texas Instruments Incorporated
 * Copyright (c) 2026 Linumiz
 *
 * SPDX-License-Identifier: Apache-2.0
 */

#include <zephyr/device.h>
#include <zephyr/drivers/comparator.h>
#include <zephyr/kernel.h>
#include <zephyr/logging/log.h>

LOG_MODULE_REGISTER(comparator_sample, LOG_LEVEL_INF);

static const struct device *comp_dev = DEVICE_DT_GET(DT_ALIAS(sample_comp));

static void comparator_callback(const struct device *dev, void *user_data)
{
	ARG_UNUSED(user_data);

	LOG_INF("comparator output changed, output = %d", comparator_get_output(dev));
}

int main(void)
{
	int ret;

	if (!device_is_ready(comp_dev)) {
		LOG_ERR("comparator device not ready");
		return 0;
	}

	ret = comparator_set_trigger_callback(comp_dev, comparator_callback, NULL);
	if (ret < 0) {
		LOG_ERR("failed to set trigger callback (%d)", ret);
		return 0;
	}

	ret = comparator_set_trigger(comp_dev, COMPARATOR_TRIGGER_BOTH_EDGES);
	if (ret < 0) {
		LOG_ERR("failed to set trigger (%d)", ret);
		return 0;
	}

	LOG_INF("comparator sample started, waiting for trigger events");

	while (1) {
		k_sleep(K_FOREVER);
	}

	return 0;
}
```
